## config/west.yml
```yaml
manifest:
  remotes:
    - name: zmkfirmware
      url-base: https://github.com/zmkfirmware
    - name: dani0854
      url-base: https://github.com/dani0854
  projects:
    - name: zmk
      remote: zmkfirmware
      revision: v0.3
      import: app/west.yml
    - name: zmk-component-weact-studio-rp2040
      remote: dani0854
      revision: main
      import: west.yml
  self:
    path: config
```
